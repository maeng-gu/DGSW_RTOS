// COL 10~17
// ROW 2~9
#define DATA 10
#define CLK 11
#define LATCH 12
char a = 0x0F;
int k, z, m, s, j;
char b[10][8] = {
        {0x00,0x38,0x44,0x4c,0x54,0x64,0x44,0x38},
        {0x00,0x10,0x30,0x50,0x10,0x10,0x10,0x7c},
        {0x00,0x38,0x44,0x04,0x08,0x10,0x20,0x7c},
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        {0x00,0x38,0x44,0x44,0x3c,0x04,0x44,0x38}
};
char b2[10][8] = {
        {0x00,0x38,0x44,0x4c,0x54,0x64,0x44,0x38},
        {0x00,0x10,0x30,0x50,0x10,0x10,0x10,0x7c},
        {0x00,0x38,0x44,0x04,0x08,0x10,0x20,0x7c},
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        {0x00,0x38,0x44,0x44,0x3c,0x04,0x44,0x38}
};
char c[8]={0x01,0x02,0x04,0x08,0x10,0x20,0x40,0x80};

unsigned long per;

void setup() {
  Serial.begin(9600);
  for (int i = 2; i < 18; i++)
  {
    pinMode(i, OUTPUT);
  }
}

void loop() {
  unsigned long cur = micros();
  if (cur - per > 1000) {
    per = cur;
    for(int jl=7;j<=0;j--){
      for (int i = 7; i<=0; i--)
      {
        if(i==j) digitalWrite(DATA, 1);
        else digitalWrite(DATA, 0);
        digitalWrite(CLK, 1);
        digitalWrite(CLK, 0);
      } 
      for (int i = 0; i < 8; i++)
      {
        if (b[m][j] & (0x01 << i)) { digitalWrite(DATA, 0);}
        else { digitalWrite(DATA, 1);}
        digitalWrite(CLK, 1);
        digitalWrite(CLK, 0);
      }
      digitalWrite(LATCH, 1);
      digitalWrite(LATCH, 0);
    }
    z++;
    if (z % 100 == 0)
    {
        m++;
        if (m == 10) {
          m = 0;
        }
    }
}
}
